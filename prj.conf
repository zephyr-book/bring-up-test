## prj.conf
```kconfig
CONFIG_SENSOR=y
CONFIG_SHELL=y

CONFIG_PWM=y
CONFIG_PWM_RPI_PICO=y

CONFIG_I2C_SHELL=y

CONFIG_ASSERT=y

CONFIG_SPI=y

CONFIG_HEAP_MEM_POOL_SIZE=32768

CONFIG_GPIO_SHELL=y

CONFIG_MAIN_STACK_SIZE=5200
CONFIG_SHELL_STACK_SIZE=5200

# Display: on P1 the OLED hangs off a bit-bang SPI bus and is driven by the
# out-of-tree oled-sh1106-zephyr module, enabled in
# boards/zbook_rp2350b_m33_p1.conf. On P2 the same panel is a plain I2C device
# handled by Zephyr's in-tree ssd1306 driver, which auto-enables from the
# devicetree, so only the subsystems need turning on here.
CONFIG_DISPLAY=y
CONFIG_CHARACTER_FRAMEBUFFER=y

# Rotary encoder (P2) reports through the input subsystem via gpio-qdec. The
# board's buttons now carry a zephyr,code, so input_gpio_keys binds to them
# cleanly and no longer has to be switched off here.
CONFIG_INPUT=y

# Wi-Fi / networking lives on the zbook_wifi shield:
#   west build -b zbook/rp2350b/m33 --shield zbook_wifi
# Add persistent credentials by composing the upstream snippet:
#   west build -b zbook/rp2350b/m33 --shield zbook_wifi -S wifi-credentials
```

## boards/zbook_rp2350b_m33_p1.conf
```kconfig
CONFIG_OLED_DISPLAY=y
CONFIG_OLED_FONTS=y
```

## src/main.c
```c
/**
 * @file main.c
 * @author Gabriel Germano <gabriel.germano@edge.ufal.br>
 * @brief Shell entry point for the ZBook bring-up firmware.
 *
 * @version 0.2
 * @date 29-01-2026
 *
 * @copyright Copyright (c) 2026 - Centro de Inovação EDGE
 *
 */
#include "addr_led_test.h"
#include "io_test.h"
#include "ir_io_test.h"
#include "ldr_test.h"
#include "pwm_test.h"

/* P2-only tests. The headers always declare their handler; the definition is
 * compiled only when the matching devicetree node exists, and `test all` guards
 * each call the same way, so nothing references a missing symbol on P1.
 */
#include "accel_test.h"
#include "encoder_test.h"
#include "hall_test.h"
#include "mic_test.h"
#include "temp_test.h"

#include <stdlib.h>
#include <zephyr/devicetree.h>
#include <zephyr/drivers/uart.h>
#include <zephyr/kernel.h>
#include <zephyr/logging/log.h>
#include <zephyr/shell/shell.h>

SHELL_SUBCMD_SET_CREATE(test_subcmds, (test));

/* `test all` runs the suite in sequence. Unlike the individual subcommands this
 * has to name every handler from one place, so the revision-specific entries
 * are bracketed here as well -- these are statements, not macro arguments, so a
 * plain #if is fine.
 */
static int cmd_test_all(const struct shell *sh, size_t argc, char **argv)
{
	int ret;

#define RUN(_name, _handler)                                                                       \
	do {                                                                                       \
		ret = _handler(sh, argc, argv);                                                    \
		if (ret < 0) {                                                                     \
			shell_fprintf(sh, SHELL_VT100_COLOR_RED, "%s test failed: %d\n", _name,    \
				      ret);                                                        \
			return ret;                                                                \
		}                                                                                  \
	} while (0)

	RUN("LDR", cmd_test_ldr);
	RUN("IO", cmd_test_io);
	RUN("PWM", cmd_test_pwm);
	RUN("Addressable LED", cmd_test_addr_led);
	RUN("IR IO", cmd_test_ir_io);

#if DT_NODE_EXISTS(DT_NODELABEL(tmp1075))
	RUN("Temperature", cmd_test_temp);
#endif
#if DT_NODE_EXISTS(DT_NODELABEL(bmi323))
	RUN("IMU", cmd_test_accel);
#endif
#if DT_NODE_EXISTS(DT_NODELABEL(microphone_adc))
	RUN("Microphone", cmd_test_mic);
#endif
#if DT_NODE_EXISTS(DT_ALIAS(hall_sensor))
	RUN("Hall sensor", cmd_test_hall);
#endif
#if DT_NODE_EXISTS(DT_NODELABEL(encoder_qdec))
	RUN("Encoder", cmd_test_encoder);
#endif

#undef RUN

	shell_fprintf(sh, SHELL_VT100_COLOR_GREEN, "All tests passed successfully.\n");
	return 0;
}

SHELL_SUBCMD_ADD((test), all, NULL, "Run every bringup test available on this revision.",
		 cmd_test_all, 1, 0);

SHELL_CMD_REGISTER(test, &test_subcmds, "Test bringup of Zbook", NULL);

int main(void)
{
	const struct device *dev;
	uint32_t dtr = 0;

	dev = DEVICE_DT_GET(DT_CHOSEN(zephyr_shell_uart));
	if (!device_is_ready(dev)) {
		return 0;
	}

	printk("ZBook bring-up firmware\n");
	printk("Board: %s\n", CONFIG_BOARD_TARGET);
	printk("Run `test -h` for the tests available on this revision.\n");

	while (!dtr) {
		uart_line_ctrl_get(dev, UART_LINE_CTRL_DTR, &dtr);
		k_sleep(K_MSEC(100));
	}
	return 0;
}
```

## include/accel_test.h
```c
#ifndef ACCEL_TEST_H
#define ACCEL_TEST_H

#include <zephyr/shell/shell.h>

int cmd_test_accel(const struct shell *sh, size_t argc, char **argv);

#endif /* ACCEL_TEST_H */
```

## include/display_test.h
```c
#ifndef DISPLAY_TEST_H
#define DISPLAY_TEST_H

#include <zephyr/shell/shell.h>

int cmd_test_display(const struct shell *sh, size_t argc, char **argv);

#endif /* DISPLAY_TEST_H */
```

## include/encoder_test.h
```c
#ifndef ENCODER_TEST_H
#define ENCODER_TEST_H

#include <zephyr/shell/shell.h>

int cmd_test_encoder(const struct shell *sh, size_t argc, char **argv);

#endif /* ENCODER_TEST_H */
```

## include/hall_test.h
```c
#ifndef HALL_TEST_H
#define HALL_TEST_H

#include <zephyr/shell/shell.h>

int cmd_test_hall(const struct shell *sh, size_t argc, char **argv);

#endif /* HALL_TEST_H */
```

## include/mic_test.h
```c
#ifndef MIC_TEST_H
#define MIC_TEST_H

#include <zephyr/shell/shell.h>

int cmd_test_mic(const struct shell *sh, size_t argc, char **argv);

#endif /* MIC_TEST_H */
```

## include/motor_test.h
```c
#ifndef MOTOR_TEST_H
#define MOTOR_TEST_H

#include <zephyr/shell/shell.h>

int cmd_test_motor(const struct shell *sh, size_t argc, char **argv);

#endif /* MOTOR_TEST_H */
```

## include/temp_test.h
```c
#ifndef TEMP_TEST_H
#define TEMP_TEST_H

#include <zephyr/shell/shell.h>

int cmd_test_temp(const struct shell *sh, size_t argc, char **argv);

#endif /* TEMP_TEST_H */
```

## src/accel_test.c
```c
/**
 * @file accel_test.c
 * @author Gabriel Germano <gabriel.germano@edge.ufal.br>
 * @brief BMI323 IMU bring-up test (P2 only).
 *
 * @version 0.1
 * @date 03-09-2026
 *
 * @copyright Copyright (c) 2026 - Centro de Inovação EDGE
 *
 */
#include "accel_test.h"

#include <zephyr/device.h>
#include <zephyr/devicetree.h>
#include <zephyr/drivers/sensor.h>
#include <zephyr/kernel.h>
#include <zephyr/shell/shell.h>

#define ACCEL_NODE DT_NODELABEL(bmi323)

#if DT_NODE_EXISTS(ACCEL_NODE)

#define SAMPLE_COUNT       10
#define SAMPLE_INTERVAL_MS 250
#define ODR_HZ             100

static const struct device *const accel_dev = DEVICE_DT_GET(ACCEL_NODE);

static int enable_channel(const struct shell *sh, enum sensor_channel chan, const char *name)
{
	struct sensor_value odr = {.val1 = ODR_HZ, .val2 = 0};
	struct sensor_value enable = {.val1 = 1, .val2 = 0};
	int ret = sensor_attr_set(accel_dev, chan, SENSOR_ATTR_SAMPLING_FREQUENCY, &odr);

	if (ret < 0) {
		shell_error(sh, "Failed to set %s ODR: %d", name, ret);
		return ret;
	}

	ret = sensor_attr_set(accel_dev, chan, SENSOR_ATTR_FEATURE_MASK, &enable);
	if (ret < 0) {
		shell_error(sh, "Failed to enable %s: %d", name, ret);
		return ret;
	}

	return 0;
}

static void print_xyz(const struct shell *sh, const char *name, const struct sensor_value *v,
		      const char *unit)
{
	shell_fprintf(sh, SHELL_NORMAL, "%s [%s] x=%lld y=%lld z=%lld\n", name, unit,
		      sensor_value_to_milli(&v[0]), sensor_value_to_milli(&v[1]),
		      sensor_value_to_milli(&v[2]));
}

int cmd_test_accel(const struct shell *sh, size_t argc, char **argv)
{
	ARG_UNUSED(argc);
	ARG_UNUSED(argv);
	int ret;

	if (!device_is_ready(accel_dev)) {
		shell_error(sh, "IMU %s not ready", accel_dev->name);
		return -ENODEV;
	}

	ret = enable_channel(sh, SENSOR_CHAN_ACCEL_XYZ, "accelerometer");
	if (ret < 0) {
		return ret;
	}

	ret = enable_channel(sh, SENSOR_CHAN_GYRO_XYZ, "gyroscope");
	if (ret < 0) {
		return ret;
	}

	/* Give the sensor a couple of conversion periods before the first read. */
	k_msleep(50);

	shell_fprintf(sh, SHELL_VT100_COLOR_GREEN, "IMU %s ready at %d Hz\n", accel_dev->name,
		      ODR_HZ);
	shell_fprintf(sh, SHELL_NORMAL, "Tilt and rotate the board to see the values change\n");

	for (int i = 0; i < SAMPLE_COUNT; i++) {
		struct sensor_value accel[3];
		struct sensor_value gyro[3];

		ret = sensor_sample_fetch(accel_dev);
		if (ret < 0) {
			shell_error(sh, "Sample fetch failed: %d", ret);
			return ret;
		}

		ret = sensor_channel_get(accel_dev, SENSOR_CHAN_ACCEL_XYZ, accel);
		if (ret < 0) {
			shell_error(sh, "Accelerometer read failed: %d", ret);
			return ret;
		}

		print_xyz(sh, "accel", accel, "mm/s^2");

		ret = sensor_channel_get(accel_dev, SENSOR_CHAN_GYRO_XYZ, gyro);
		if (ret < 0) {
			/* Not fatal: the accelerometer half already proved the bus. */
			shell_warn(sh, "Gyroscope read failed: %d", ret);
		} else {
			print_xyz(sh, "gyro ", gyro, "mrad/s");
		}

		k_msleep(SAMPLE_INTERVAL_MS);
	}

	shell_fprintf(sh, SHELL_VT100_COLOR_GREEN, "IMU test completed\n");
	return 0;
}

SHELL_SUBCMD_ADD((test), accel, NULL, "Initialize the bringup test for the IMU (P2).",
		 cmd_test_accel, 1, 0);

#endif /* DT_NODE_EXISTS(ACCEL_NODE) */
```

## src/addr_led_test.c
```c
/**
 * @file addr_led_test.c
 * @author Vinicius Ramos <vinicius.ramos@edge.ufal.br>
 * @brief WS2812 addressable LED bring-up test.
 *
 * @version 0.1
 * @date 23-02-2026
 *
 * @copyright Copyright (c) 2026 - Centro de Inovação EDGE
 *
 */
#include "addr_led_test.h"

#include "zephyr/devicetree.h"
#include <stdio.h>
#include <string.h>
#include <zephyr/device.h>
#include <zephyr/drivers/gpio.h>
#include <zephyr/drivers/uart.h>
#include <zephyr/drivers/led_strip.h>
#include <zephyr/drivers/spi.h>
#include <zephyr/kernel.h>
#include <zephyr/logging/log.h>
#include <zephyr/sys/ring_buffer.h>
#include <zephyr/shell/shell.h>

#define SLEEP_TIME_MS 10
#define SAMPLE_LED_BRIGHTNESS 0xFF
#define SAMPLE_LED_UPDATE_DELAY 50

#if DT_NODE_HAS_PROP(DT_ALIAS(led_strip), chain_length)
#define STRIP_NUM_PIXELS	DT_PROP(DT_ALIAS(led_strip), chain_length)
#else
#error Unable to determine length of LED strip
#endif

#define DELAY_TIME K_MSEC(SAMPLE_LED_UPDATE_DELAY)
#define RGB(_r, _g, _b) { .r = (_r), .g = (_g), .b = (_b) }

static const struct led_rgb colors[] = {
	RGB(SAMPLE_LED_BRIGHTNESS, 0x00, 0x00), /* red */
	RGB(0x00, SAMPLE_LED_BRIGHTNESS, 0x00), /* green */
	RGB(0x00, 0x00, SAMPLE_LED_BRIGHTNESS), /* blue */
};

static struct led_rgb pixels[STRIP_NUM_PIXELS];

static const struct device *const led_strip = DEVICE_DT_GET(DT_ALIAS(led_strip));

static const struct gpio_dt_spec up_button = GPIO_DT_SPEC_GET(DT_ALIAS(button0), gpios);
static const struct gpio_dt_spec down_button = GPIO_DT_SPEC_GET(DT_ALIAS(button3), gpios);
static const struct gpio_dt_spec right_button = GPIO_DT_SPEC_GET(DT_ALIAS(button1), gpios);

static int init_buttons(const struct shell *sh)
{
	int ret;

    if (!gpio_is_ready_dt(&up_button)) {
        shell_error(sh, "Up Button device not ready");
        return -ENODEV;
    }

    ret = gpio_pin_configure_dt(&up_button, GPIO_INPUT);
    if (ret < 0) {
        shell_error(sh, "Failed to configure up button: %d", ret);
        return ret;
    }

    if (!gpio_is_ready_dt(&down_button)) {
        shell_error(sh, "Down Button device not ready");
        return -ENODEV;
    }

    ret = gpio_pin_configure_dt(&down_button, GPIO_INPUT);
    if (ret < 0) {
        shell_error(sh, "Failed to configure down button: %d", ret);
        return ret;
    }

    if (!gpio_is_ready_dt(&right_button)) {
        shell_error(sh, "Right Button device not ready");
        return -ENODEV;
    }

    ret = gpio_pin_configure_dt(&right_button, GPIO_INPUT);
    if (ret < 0) {
        shell_error(sh, "Failed to configure right button: %d", ret);
        return ret;
    }

	shell_fprintf(sh, SHELL_VT100_COLOR_GREEN, "Buttons initialized\n");
	return 0;
}

static int init_addr_led(void)
{
    if (!device_is_ready(led_strip)) {
        return -ENODEV;
    }

    return 0;
}

int cmd_test_addr_led(const struct shell *sh, size_t argc, char **argv)
{
	ARG_UNUSED(argc);
	ARG_UNUSED(argv);
	int ret, previous_state_up = 0, previous_state_down = 0, previous_state_right = 0;
    size_t color = 0;
    bool test_passed = true;

    ret = init_addr_led();
    if (ret < 0) {
        shell_error(sh, "Addressable LED device not ready: %d", ret);
        return ret;
    }

    ret = init_buttons(sh);
	if (ret < 0) {
		shell_error(sh, "Buttons initialization failed: %d\n", ret);
		return ret;
	}

	shell_fprintf(sh, SHELL_VT100_COLOR_GREEN, "Addressable LED Test started, press the UP key if test passed, DOWN if test failed\n");

	while (1) {
        for (size_t cursor = 0; cursor < ARRAY_SIZE(pixels); cursor++) {
			memset(&pixels, 0x00, sizeof(pixels));
			memcpy(&pixels[cursor], &colors[color], sizeof(struct led_rgb));

			ret = led_strip_update_rgb(led_strip, pixels, STRIP_NUM_PIXELS);
			if (ret) {
                shell_error(sh, "Couldn't update LED strip: %d\n", ret);
                return ret;
            }

			k_sleep(DELAY_TIME);
		}

        int current_up = gpio_pin_get_dt(&up_button);
        int current_down = gpio_pin_get_dt(&down_button);
        int current_right = gpio_pin_get_dt(&right_button);

        if (current_up == 1 && previous_state_up == 0) {
            shell_fprintf(sh, SHELL_NORMAL,
                        "Up button pressed -> TEST PASSED\n");
            break;
        }

        if (current_down == 1 && previous_state_down == 0) {
            shell_fprintf(sh, SHELL_NORMAL,
                        "Down button pressed -> TEST FAILED\n");
            test_passed = false;
            break;
        }

        if (current_right == 1 && previous_state_right == 0) {
            shell_fprintf(sh, SHELL_NORMAL,
                        "Right button pressed -> Change color\n");
            color = (color + 1) % ARRAY_SIZE(colors);
        }

        previous_state_up = current_up;
        previous_state_down = current_down;
        previous_state_right = current_right;
		k_msleep(SLEEP_TIME_MS);
	}

    memset(&pixels, 0x00, sizeof(pixels));
    ret = led_strip_update_rgb(led_strip, pixels, STRIP_NUM_PIXELS);
    if (ret) {
        shell_error(sh, "Couldn't update LED strip: %d\n", ret);
        return ret;
    }

    if (test_passed) {
        shell_fprintf(sh, SHELL_VT100_COLOR_GREEN, "Addressable LED test passed successfully.\n");
        return 0;
    } else {
        shell_fprintf(sh, SHELL_VT100_COLOR_RED, "Addressable LED test failed.\n");
        return -1;
    }
}

SHELL_SUBCMD_ADD((test), addr_led, NULL, "Initialize the bringup test for Addressable LED Module.", cmd_test_addr_led, 1, 0);
```

## src/display_test.c
```c
/**
 * @file display_test.c
 * @author Gabriel Germano <gabriel.germano@edge.ufal.br>
 * @brief OLED bring-up test.
 *
 * @version 0.2
 * @date 29-01-2026
 *
 * @copyright Copyright (c) 2026 - Centro de Inovação EDGE
 *
 */
#include "display_test.h"

#include <zephyr/device.h>
#include <zephyr/devicetree.h>
#include <zephyr/kernel.h>
#include <zephyr/shell/shell.h>

#define ZBOOK_BITMAP_W      100
#define ZBOOK_BITMAP_H      50
/* Row-major, MSB-first, one bit per pixel. */
#define ZBOOK_BITMAP_STRIDE ((ZBOOK_BITMAP_W + 7) / 8)

static const unsigned char zbook_bitmap[] = {
	// 'Gemini_Generated_Image_mh1mqmh1mqmh1mqm, 100x50px
	0x00, 0x00, 0x00, 0x00, 0x00, 0x00, 0x00, 0x00, 0x00, 0x00, 0x00, 0x00, 0x00, 0x00, 0x00,
	0x00, 0x00, 0x00, 0x00, 0x00, 0x00, 0x00, 0x00, 0x00, 0x00, 0x00, 0x00, 0x00, 0x00, 0x00,
	0x00, 0x00, 0x00, 0x00, 0x00, 0x00, 0x00, 0x00, 0x00, 0x00, 0x00, 0x00, 0x00, 0x00, 0x00,
	0x00, 0x00, 0x00, 0x00, 0x00, 0x00, 0x00, 0x00, 0x00, 0x00, 0x00, 0x00, 0x00, 0x00, 0x00,
	0x00, 0x00, 0x00, 0x00, 0x00, 0x00, 0x00, 0x00, 0x00, 0x00, 0x00, 0x00, 0x00, 0x00, 0x00,
	0x00, 0x00, 0x00, 0x00, 0x00, 0x00, 0x00, 0x00, 0x00, 0x00, 0x00, 0x00, 0x00, 0x00, 0x00,
	0x00, 0x00, 0x00, 0x00, 0x00, 0x00, 0x00, 0x00, 0x00, 0x00, 0x00, 0x00, 0x00, 0x00, 0x00,
	0x00, 0x00, 0x00, 0x00, 0x00, 0x00, 0x00, 0x00, 0x00, 0x00, 0x00, 0x00, 0x00, 0x00, 0x00,
	0x00, 0x00, 0x00, 0x00, 0x00, 0x00, 0x00, 0x00, 0x00, 0x00, 0x00, 0x00, 0x00, 0x00, 0x00,
	0x00, 0x00, 0x00, 0x00, 0x00, 0x00, 0x00, 0x00, 0x00, 0x00, 0x00, 0x00, 0x00, 0x00, 0x00,
	0x00, 0x00, 0x00, 0x00, 0x00, 0x00, 0x00, 0x00, 0x00, 0x00, 0x00, 0x00, 0x00, 0x00, 0x00,
	0x00, 0x00, 0x00, 0x00, 0x00, 0x00, 0x00, 0x00, 0x00, 0x00, 0x00, 0x00, 0x00, 0x00, 0x00,
	0x00, 0x00, 0x00, 0x00, 0x07, 0xff, 0xfe, 0x00, 0x00, 0x00, 0x00, 0x00, 0x00, 0x00, 0x00,
	0x00, 0x00, 0x0f, 0xff, 0xfc, 0x00, 0x00, 0x00, 0x00, 0x00, 0x00, 0x00, 0x00, 0x00, 0x00,
	0x1f, 0xff, 0xfc, 0x00, 0x00, 0x00, 0x00, 0x00, 0x00, 0x00, 0x00, 0x00, 0x00, 0x1f, 0xff,
	0xf8, 0x00, 0x00, 0x00, 0x00, 0x00, 0x00, 0x00, 0x00, 0x00, 0x00, 0x00, 0x01, 0xf0, 0x60,
	0x00, 0x00, 0x00, 0x30, 0x00, 0x00, 0x00, 0x00, 0x00, 0x00, 0x03, 0xe0, 0x60, 0x00, 0x00,
	0x00, 0x30, 0x00, 0x00, 0x00, 0x00, 0x00, 0x00, 0x03, 0xc0, 0x60, 0x00, 0x00, 0x00, 0x30,
	0x00, 0x00, 0x00, 0x00, 0x00, 0x00, 0x27, 0xc0, 0x60, 0x00, 0x00, 0x00, 0x30, 0x00, 0x00,
	0x00, 0x00, 0x00, 0x00, 0x2f, 0x80, 0x6f, 0x83, 0xe0, 0x7c, 0x30, 0xc0, 0x00, 0x00, 0x00,
	0x00, 0x00, 0x5f, 0x00, 0x7f, 0xc7, 0xf8, 0xfe, 0x31, 0x80, 0x00, 0x00, 0x00, 0x00, 0x00,
	0x7e, 0x00, 0x70, 0xce, 0x19, 0xc3, 0x33, 0x80, 0x00, 0x00, 0x00, 0x00, 0x00, 0xfe, 0x00,
	0x60, 0x6c, 0x0d, 0x83, 0xb7, 0x00, 0x00, 0x00, 0x00, 0x00, 0x00, 0xfc, 0x00, 0x60, 0x6c,
	0x0d, 0x81, 0xbe, 0x00, 0x00, 0x00, 0x00, 0x00, 0x01, 0xf8, 0x00, 0x60, 0x6c, 0x0d, 0x81,
	0xbf, 0x00, 0x00, 0x00, 0x00, 0x00, 0x03, 0xf0, 0x00, 0x60, 0x6c, 0x1d, 0x83, 0x39, 0x80,
	0x00, 0x00, 0x00, 0x00, 0x03, 0xe0, 0x00, 0x70, 0xc6, 0x19, 0xc3, 0x31, 0xc0, 0x00, 0x00,
	0x00, 0x00, 0x07, 0xe0, 0x00, 0x7f, 0xc7, 0xf0, 0xfe, 0x30, 0xc0, 0x00, 0x00, 0x00, 0x00,
	0x0f, 0xc0, 0x00, 0x67, 0x01, 0xe0, 0x3c, 0x30, 0x60, 0x00, 0x00, 0x00, 0x00, 0x0f, 0xff,
	0xf8, 0x00, 0x00, 0x00, 0x00, 0x00, 0x00, 0x00, 0x00, 0x00, 0x00, 0x1f, 0xff, 0xf0, 0x00,
	0x00, 0x00, 0x00, 0x00, 0x00, 0x00, 0x00, 0x00, 0x00, 0x3f, 0xff, 0xf0, 0x00, 0x00, 0x00,
	0x00, 0x00, 0x00, 0x00, 0x00, 0x00, 0x00, 0x3f, 0xff, 0xe0, 0x00, 0x00, 0x00, 0x00, 0x00,
	0x00, 0x00, 0x00, 0x00, 0x00, 0x00, 0x00, 0x00, 0x00, 0x00, 0x00, 0x00, 0x00, 0x00, 0x00,
	0x00, 0x00, 0x00, 0x00, 0x00, 0x00, 0x00, 0x00, 0x00, 0x00, 0x00, 0x00, 0x00, 0x00, 0x00,
	0x00, 0x00, 0x00, 0x00, 0x00, 0x00, 0x00, 0x00, 0x00, 0x00, 0x00, 0x00, 0x00, 0x00, 0x00,
	0x00, 0x00, 0x00, 0x00, 0x00, 0x00, 0x00, 0x00, 0x00, 0x00, 0x00, 0x00, 0x00, 0x00, 0x00,
	0x00, 0x00, 0x00, 0x00, 0x00, 0x00, 0x00, 0x00, 0x00, 0x00, 0x00, 0x00, 0x00, 0x00, 0x00,
	0x00, 0x00, 0x00, 0x00, 0x00, 0x00, 0x00, 0x00, 0x00, 0x00, 0x00, 0x00, 0x00, 0x00, 0x00,
	0x00, 0x00, 0x00, 0x00, 0x00, 0x00, 0x00, 0x00, 0x00, 0x00, 0x00, 0x00, 0x00, 0x00, 0x00,
	0x00, 0x00, 0x00, 0x00, 0x00, 0x00, 0x00, 0x00, 0x00, 0x00, 0x00, 0x00, 0x00, 0x00, 0x00,
	0x00, 0x00, 0x00, 0x00, 0x00, 0x00, 0x00, 0x00, 0x00, 0x00, 0x00, 0x00, 0x00, 0x00, 0x00,
	0x00, 0x00, 0x00, 0x00, 0x00, 0x00, 0x00, 0x00, 0x00, 0x00, 0x00, 0x00, 0x00, 0x00, 0x00,
	0x00, 0x00, 0x00, 0x00, 0x00, 0x00, 0x00, 0x00, 0x00, 0x00, 0x00, 0x00, 0x00, 0x00, 0x00,
	0x00, 0x00, 0x00, 0x00, 0x00, 0x00, 0x00, 0x00, 0x00, 0x00, 0x00, 0x00, 0x00, 0x00, 0x00,
	0x00, 0x00, 0x00, 0x00, 0x00};

#if DT_HAS_CHOSEN(zephyr_display)
/* ---------------------------------------------------------------- P2 (I2C) */

#include <zephyr/display/cfb.h>
#include <zephyr/drivers/display.h>

static const struct device *const display_dev = DEVICE_DT_GET(DT_CHOSEN(zephyr_display));

static inline bool bitmap_pixel(uint16_t x, uint16_t y)
{
	size_t bit = (size_t)y * ZBOOK_BITMAP_STRIDE * 8 + x;
	size_t byte = bit / 8;

	if (byte >= ARRAY_SIZE(zbook_bitmap)) {
		return false;
	}

	return (zbook_bitmap[byte] >> (7 - (bit % 8))) & 0x01;
}

static int narrowest_font(const struct device *dev)
{
	int count = cfb_get_numof_fonts(dev);
	int best = -ENOENT;
	uint8_t best_width = UINT8_MAX;

	for (int i = 0; i < count; i++) {
		uint8_t w, h;

		if (cfb_get_font_size(dev, i, &w, &h) != 0) {
			continue;
		}

		if (w > 0 && w < best_width) {
			best_width = w;
			best = i;
		}
	}

	return best;
}

static int display_run(const struct shell *sh)
{
	int ret;
	int font;

	if (!device_is_ready(display_dev)) {
		shell_error(sh, "Display device %s not ready", display_dev->name);
		return -ENODEV;
	}

	ret = display_blanking_off(display_dev);
	if (ret < 0) {
		shell_error(sh, "Failed to turn blanking off: %d", ret);
		return ret;
	}

	ret = cfb_framebuffer_init(display_dev);
	if (ret < 0) {
		shell_error(sh, "Framebuffer init failed: %d", ret);
		return ret;
	}

	font = narrowest_font(display_dev);
	if (font < 0) {
		shell_error(sh, "No CFB font available: %d", font);
		return font;
	}

	ret = cfb_framebuffer_set_font(display_dev, (uint8_t)font);
	if (ret < 0) {
		shell_error(sh, "Failed to select font %d: %d", font, ret);
		return ret;
	}

	shell_fprintf(sh, SHELL_VT100_COLOR_GREEN, "Display %s initialized\n",
		      display_dev->name);

	/* Frame 1: concentric circles with a caption, mirroring the P1 test. */
	(void)cfb_framebuffer_clear(display_dev, false);

	const struct cfb_position centre = {.x = 64, .y = 32};

	for (uint16_t r = 28; r <= 30; r++) {
		ret = cfb_draw_circle(display_dev, &centre, r);
		if (ret < 0) {
			shell_error(sh, "Circle draw failed: %d", ret);
			return ret;
		}
	}

	ret = cfb_print(display_dev, "ZBook P2", 0, 0);
	if (ret < 0) {
		shell_error(sh, "Text draw failed: %d", ret);
		return ret;
	}

	ret = cfb_framebuffer_finalize(display_dev);
	if (ret < 0) {
		shell_error(sh, "Framebuffer flush failed: %d", ret);
		return ret;
	}

	k_msleep(5000);

	(void)cfb_framebuffer_clear(display_dev, false);

	for (uint16_t y = 0; y < ZBOOK_BITMAP_H; y++) {
		for (uint16_t x = 0; x < ZBOOK_BITMAP_W; x++) {
			if (!bitmap_pixel(x, y)) {
				continue;
			}

			const struct cfb_position p = {.x = (uint16_t)(x + 12),
						       .y = (uint16_t)(y + 7)};

			(void)cfb_draw_point(display_dev, &p);
		}
	}

	ret = cfb_framebuffer_finalize(display_dev);
	if (ret < 0) {
		shell_error(sh, "Framebuffer flush failed: %d", ret);
		return ret;
	}

	k_msleep(5000);

	(void)cfb_framebuffer_clear(display_dev, true);
	(void)cfb_framebuffer_finalize(display_dev);
	(void)display_blanking_on(display_dev);

	return 0;
}

#else

#include "display.h"
#include "fonts.h"

#include <zephyr/drivers/gpio.h>

static const struct gpio_dt_spec display_reset =
	GPIO_DT_SPEC_GET(DT_NODELABEL(display_reset), gpios);

static const struct gpio_dt_spec display_en = GPIO_DT_SPEC_GET(DT_NODELABEL(display_en), gpios);

static int init_pins(const struct shell *sh)
{
	int ret = gpio_pin_configure_dt(&display_reset, GPIO_OUTPUT_ACTIVE);
	if (ret < 0) {
		shell_fprintf(sh, SHELL_VT100_COLOR_RED, "reset pin configuration failed");
		return ret;
	}

	ret = gpio_pin_set_dt(&display_reset, 1);
	if (ret < 0) {
		shell_fprintf(sh, SHELL_VT100_COLOR_RED, "reset pin set failed");
		return ret;
	}

	ret = gpio_pin_configure_dt(&display_en, GPIO_OUTPUT_ACTIVE);
	if (ret < 0) {
		shell_fprintf(sh, SHELL_VT100_COLOR_RED, "enable pin configuration failed");
		return ret;
	}

	ret = gpio_pin_set_dt(&display_en, 1);
	if (ret < 0) {
		shell_fprintf(sh, SHELL_VT100_COLOR_RED, "enable pin set failed");
		return ret;
	}

	return 0;
}

static void display_clear_and_flush(void)
{
	int ret = gpio_pin_set_dt(&display_en, 0);
	if (ret < 0) {
		return;
	}

	ret = gpio_pin_set_dt(&display_reset, 1);
	if (ret < 0) {
		return;
	}

	ret = gpio_pin_set_dt(&display_reset, 0);
	if (ret < 0) {
		return;
	}
}

static int display_run(const struct shell *sh)
{
	int ret;

	display_init();

	ret = init_pins(sh);
	if (ret < 0) {
		shell_fprintf(sh, SHELL_VT100_COLOR_RED, "pin initialization failed");
		return ret;
	}

	shell_fprintf(sh, SHELL_VT100_COLOR_GREEN, "Pins initialized successfully\n");

	display_enable();
	display_clear();
	display_set_draw_mode(DISPLAY_PIXEL_WHITE);
	display_draw_circle(64, 32, 30);
	display_draw_circle(64, 32, 29);
	display_draw_circle(64, 32, 28);
	display_set_draw_mode(DISPLAY_PIXEL_INVERT);
	display_print("Hello, World!", 27, 19, FONT_SIZE_10, 1);
	display_set_draw_mode(DISPLAY_PIXEL_WHITE);
	display_flush();

	k_msleep(5000);

	display_clear();
	display_draw_bitmap(zbook_bitmap, 12, 7, ZBOOK_BITMAP_W, ZBOOK_BITMAP_H, 1);
	display_flush();

	k_msleep(5000);

	display_clear_and_flush();

	return 0;
}

#endif /* DT_HAS_CHOSEN(zephyr_display) */

int cmd_test_display(const struct shell *sh, size_t argc, char **argv)
{
	ARG_UNUSED(argc);
	ARG_UNUSED(argv);

	return display_run(sh);
}

SHELL_SUBCMD_ADD((test), display, NULL, "Initialize the bringup test for Display Module.",
		 cmd_test_display, 1, 0);
```

## src/encoder_test.c
```c
/**
 * @file encoder_test.c
 * @author Gabriel Germano <gabriel.germano@edge.ufal.br>
 * @brief PEC12R rotary encoder bring-up test (P2 only).
 *
 * @version 0.1
 * @date 03-09-2026
 *
 * @copyright Copyright (c) 2026 - Centro de Inovação EDGE
 *
 */
#include "encoder_test.h"

#include <zephyr/devicetree.h>
#include <zephyr/drivers/gpio.h>
#include <zephyr/input/input.h>
#include <zephyr/dt-bindings/input/input-event-codes.h>
#include <zephyr/kernel.h>
#include <zephyr/shell/shell.h>

#define QDEC_NODE DT_NODELABEL(encoder_qdec)

#if DT_NODE_EXISTS(QDEC_NODE)

#define POLL_INTERVAL_MS 20
#define TEST_DURATION_MS 20000

static const struct device *const qdec_dev = DEVICE_DT_GET(QDEC_NODE);
static const struct gpio_dt_spec enc_button = GPIO_DT_SPEC_GET(DT_ALIAS(enc_button), gpios);

static atomic_t enc_position;
static atomic_t enc_events;

static void encoder_callback(struct input_event *evt, void *user_data)
{
	ARG_UNUSED(user_data);

	if (evt->type != INPUT_EV_REL || evt->code != INPUT_REL_WHEEL) {
		return;
	}

	atomic_add(&enc_position, evt->value);
	atomic_inc(&enc_events);
}

INPUT_CALLBACK_DEFINE(qdec_dev, encoder_callback, NULL);

int cmd_test_encoder(const struct shell *sh, size_t argc, char **argv)
{
	ARG_UNUSED(argc);
	ARG_UNUSED(argv);
	int ret;
	atomic_val_t last_reported;

	if (!device_is_ready(qdec_dev)) {
		shell_error(sh, "Encoder device %s not ready", qdec_dev->name);
		return -ENODEV;
	}

	if (!gpio_is_ready_dt(&enc_button)) {
		shell_error(sh, "Encoder push-switch not ready");
		return -ENODEV;
	}

	ret = gpio_pin_configure_dt(&enc_button, GPIO_INPUT);
	if (ret < 0) {
		shell_error(sh, "Failed to configure encoder switch: %d", ret);
		return ret;
	}

	atomic_set(&enc_position, 0);
	atomic_set(&enc_events, 0);
	last_reported = 0;

	shell_fprintf(sh, SHELL_VT100_COLOR_GREEN, "Encoder test started\n");
	shell_fprintf(sh, SHELL_NORMAL,
		      "Turn the shaft to move the counter; press it to finish (%d s timeout)\n",
		      TEST_DURATION_MS / 1000);

	for (int elapsed = 0; elapsed < TEST_DURATION_MS; elapsed += POLL_INTERVAL_MS) {
		atomic_val_t position = atomic_get(&enc_position);

		if (position != last_reported) {
			shell_fprintf(sh, SHELL_NORMAL, "Encoder position: %ld (%s)\n",
				      (long)position,
				      position > last_reported ? "CW" : "CCW");
			last_reported = position;
		}

		if (gpio_pin_get_dt(&enc_button) == 1) {
			shell_fprintf(sh, SHELL_NORMAL, "Encoder switch pressed\n");

			/* Crude debounce: wait for release before returning. */
			while (gpio_pin_get_dt(&enc_button) == 1) {
				k_msleep(POLL_INTERVAL_MS);
			}
			break;
		}

		k_msleep(POLL_INTERVAL_MS);
	}

	if (atomic_get(&enc_events) == 0) {
		shell_fprintf(sh, SHELL_VT100_COLOR_RED,
			      "No rotation detected -- check ENC_A/ENC_B wiring\n");
		return -EIO;
	}

	shell_fprintf(sh, SHELL_VT100_COLOR_GREEN,
		      "Encoder test completed (%ld events, final position %ld)\n",
		      (long)atomic_get(&enc_events), (long)atomic_get(&enc_position));
	return 0;
}

SHELL_SUBCMD_ADD((test), encoder, NULL,
		 "Initialize the bringup test for the rotary encoder (P2).", cmd_test_encoder, 1,
		 0);

#endif /* DT_NODE_EXISTS(QDEC_NODE) */
```

## src/hall_test.c
```c
/**
 * @file hall_test.c
 * @author Gabriel Germano <gabriel.germano@edge.ufal.br>
 * @brief Hall sensor bring-up test (P2 only).
 *
 * @version 0.1
 * @date 03-09-2026
 *
 * @copyright Copyright (c) 2026 - Centro de Inovação EDGE
 *
 */
#include "hall_test.h"

#include <zephyr/devicetree.h>
#include <zephyr/drivers/gpio.h>
#include <zephyr/kernel.h>
#include <zephyr/shell/shell.h>

#define HALL_NODE DT_ALIAS(hall_sensor)

#if DT_NODE_EXISTS(HALL_NODE)

#define POLL_INTERVAL_MS 20
#define TEST_DURATION_MS 15000

static const struct gpio_dt_spec hall = GPIO_DT_SPEC_GET(HALL_NODE, gpios);

int cmd_test_hall(const struct shell *sh, size_t argc, char **argv)
{
	ARG_UNUSED(argc);
	ARG_UNUSED(argv);
	int ret;
	int transitions = 0;
	int previous;

	if (!gpio_is_ready_dt(&hall)) {
		shell_error(sh, "Hall sensor GPIO not ready");
		return -ENODEV;
	}

	ret = gpio_pin_configure_dt(&hall, GPIO_INPUT);
	if (ret < 0) {
		shell_error(sh, "Failed to configure hall sensor: %d", ret);
		return ret;
	}

	previous = gpio_pin_get_dt(&hall);
	if (previous < 0) {
		shell_error(sh, "Failed to read hall sensor: %d", previous);
		return previous;
	}

	shell_fprintf(sh, SHELL_VT100_COLOR_GREEN, "Hall sensor test started\n");
	shell_fprintf(sh, SHELL_NORMAL,
		      "Move a magnet near the sensor. Initial state: %s. Running %d s...\n",
		      previous ? "DETECTED" : "idle", TEST_DURATION_MS / 1000);

	for (int elapsed = 0; elapsed < TEST_DURATION_MS; elapsed += POLL_INTERVAL_MS) {
		int current = gpio_pin_get_dt(&hall);

		if (current < 0) {
			shell_error(sh, "Failed to read hall sensor: %d", current);
			return current;
		}

		if (current != previous) {
			transitions++;
			shell_fprintf(sh, SHELL_NORMAL, "Hall sensor -> %s\n",
				      current ? "DETECTED" : "idle");
			previous = current;
		}

		k_msleep(POLL_INTERVAL_MS);
	}

	if (transitions == 0) {
		shell_fprintf(sh, SHELL_VT100_COLOR_RED,
			      "No transitions seen -- sensor stuck at %s\n",
			      previous ? "DETECTED" : "idle");
		return -EIO;
	}

	shell_fprintf(sh, SHELL_VT100_COLOR_GREEN,
		      "Hall sensor test passed (%d transitions)\n", transitions);
	return 0;
}

SHELL_SUBCMD_ADD((test), hall, NULL, "Initialize the bringup test for the Hall sensor (P2).",
		 cmd_test_hall, 1, 0);

#endif /* DT_NODE_EXISTS(HALL_NODE) */
```
